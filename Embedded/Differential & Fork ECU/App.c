/**********************************************************************************************************************
 *  FILE DESCRIPTION
 *  -----------------------------------------------------------------------------------------------------------------*/
/**        \file  App.c
 *        \brief  Application Driver
 *
 *      \details  Source File For Application Driver
 *
 *
 *********************************************************************************************************************/

/**********************************************************************************************************************
 *  INCLUDES
 *********************************************************************************************************************/
#include "Std_Types.h"
#include "Port.h"
#include "Dio.h"
#include "Gptm.h"
#include "IntCtrl.h"
#include "Adc.h"
#include "Uart.h"
#include "PID.h"
#include "PWM.h"
#include "Encoder.h"
#include "Differential.h"
/**********************************************************************************************************************
 *  LOCAL MACROS CONSTANT\FUNCTION
 *********************************************************************************************************************/

/**********************************************************************************************************************
 *  LOCAL DATA
 *********************************************************************************************************************/

/**********************************************************************************************************************
 *  GLOBAL DATA
 *********************************************************************************************************************/
float linear_Vel = 0.0;
float Angular_Vel = 0.0;
float SetPoint = 0.0;

extern float Right_Ticks ;
extern float Left_Ticks ;

extern char str[11];
extern char* data ;

static float num1 = 0.01 ;
static float num2 = 0.01;
extern float32 SetPoint_S;
float32  SetPoint_Steering;
extern float32 SetPoint_D;
float32 SetPoint_Diferential;
extern float32 Output_D ;
extern float32 Output_S ;
float32 Setring_Angle;

float Number_1_Encoder = 0.0;
extern int Check;
extern float Steering;

extern float Numbers_Recive[3];
float Numbers_Send[3];
float Numbers_Send_PID = 0.0;
extern int numCount ;
PID_Conroller* ptr=NULL_PTR;
float measurement=0.0;
float Steering_Encoder = 0.0 ;

char Stop ;
float32 SetPoint_D = 0;
float32 Output_D ;
float Size_FLoat_Differential;
int Size_Int_Differential ;

float Numbers_Send_tiva_1;

float Numbers_Send_esp_1;
float Numbers_Send_esp_2;

char sending_buffer_1[11] ;
char sending_buffer_2[6] ;
float32 SetPoint1=0.0;
float32 SetPoint2=0.0;
extern float velWheel;

float Cos_Values[361]={0.0, 0.008726535498374, 0.017452406437283, 0.026176948307873, 0.034899496702501, 0.043619387365336, 0.052335956242944, 0.061048539534857, 0.069756473744126, 0.078459095727845, 0.087155742747658, 0.095845752520224, 0.104528463267653,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 0.008726535498374, 0.0};

/**********************************************************************************************************************
 *  LOCAL FUNCTION PROTOTYPES
 *********************************************************************************************************************/

/**********************************************************************************************************************
 *  LOCAL FUNCTIONS
 *********************************************************************************************************************/
/**********************************************************************************************************************
 *  GLOBAL FUNCTIONS
 *********************************************************************************************************************/
/******************************************************************************
 * \SyntaBluetooth_Value          : Std_ReturnType FunctionName(AnyType parameterName)
 * \Description     : Describe this service
 *
 * \Sync\Async      : Synchronous
 * \Reentrancy      : Non Reentrant
 * \Parameters (in) : parameterName   Parameter Describtion
 * \Parameters (out): None
 * \Return value:   : Std_ReturnType  E_OK
 *                                    E_NOT_OK
 *******************************************************************************/
void Init_Drivers (void)
{
    //Enable_Exceptions();
    Dio_Init(&Dio_Configuration);
    Port_Init(&Port_ConfigPtr);
    Uart_init(&Uart_ConfigPtr);
    Gpt_init(&Gpt_ConfigPtr);

//    Gpt_StartTimer (TIMER0_A,800);
//    Gpt_EnableNotification(TIMER0_A);

    Gpt_StartTimer (TIMER1_A,15999);
    Gpt_EnableNotification(TIMER1_A);

    ADC_InitChannel(&Adc_ConfigPtr);
    Pwm_Init(&Pwm_ConfigPtr);
    EncoderChannelA_Init (&Encoder_ConfigPtr1);
    EncoderChannelB_Init (&Encoder_ConfigPtr2);
    IntCtrl_init(&IntCtrl_ConfigPtr);

}

/******************************************************************************
 * \SyntaBluetooth_Value          : Std_ReturnType FunctionName(AnyType parameterName)
 * \Description     : Describe this service
 *
 * \Sync\Async      : Synchronous
 * \Reentrancy      : Non Reentrant
 * \Parameters (in) : parameterName   Parameter Describtion
 * \Parameters (out): None
 * \Return value:   : Std_ReturnType  E_OK
 *                                    E_NOT_OK
 *******************************************************************************/
void Timer0A_ISR()
{
    TICKS++;
}

/******************************************************************************
 * \SyntaBluetooth_Value          : Std_ReturnType FunctionName(AnyType parameterName)
 * \Description     : Describe this service
 *
 * \Sync\Async      : Synchronous
 * \Reentrancy      : Non Reentrant
 * \Parameters (in) : parameterName   Parameter Describtion
 * \Parameters (out): None
 * \Return value:   : Std_ReturnType  E_OK
 *                                    E_NOT_OK
 *******************************************************************************/

void Delay(unsigned long counter)
{
    unsigned long i = 0;

    for(i=0; i< counter*1000; i++);
}
/******************************************************************************
 * \SyntaBluetooth_Value          : Std_ReturnType FunctionName(AnyType parameterName)
 * \Description     : Describe this service
 *
 * \Sync\Async      : Synchronous
 * \Reentrancy      : Non Reentrant
 * \Parameters (in) : parameterName   Parameter Describtion
 * \Parameters (out): None
 * \Return value:   : Std_ReturnType  E_OK
 *                                    E_NOT_OK
 *******************************************************************************/
void Timer1A_ISR()
{
    TICKS1++;
}

/******************************************************************************
 * \SyntaBluetooth_Value          : Std_ReturnType FunctionName(AnyType parameterName)
 * \Description     : Describe this service
 *
 * \Sync\Async      : Synchronous
 * \Reentrancy      : Non Reentrant
 * \Parameters (in) : parameterName   Parameter Describtion
 * \Parameters (out): None
 * \Return value:   : Std_ReturnType  E_OK
 *                                    E_NOT_OK
 *******************************************************************************/
uint8 Time_Sec (LedSec sec)
{
    uint8 Time ;
    Time = sec ;
    return Time;
}

/******************************************************************************
 * \SyntaBluetooth_Value          : Std_ReturnType FunctionName(AnyType parameterName)
 * \Description     : Describe this service
 *
 * \Sync\Async      : Synchronous
 * \Reentrancy      : Non Reentrant
 * \Parameters (in) : parameterName   Parameter Describtion
 * \Parameters (out): None
 * \Return value:   : Std_ReturnType  E_OK
 *                                    E_NOT_OK
 *******************************************************************************/
void App_Start (void)
{

    PID_Conroller test1;
    test1.ki=0;
    test1.kp=600;
    test1.kd=0;

    test1.MaxLevel=1000;
    test1.Minlevel=-1000;
    test1.IntMaxLevel=700;
    test1.IntMinLevel=-700;
    test1.T=1;
    PID_Conroller* ptr=&test1;
    PID_init(ptr);


    while(1)
    {
//        Dio_WriteChannel(DioConf_ENCODER_VELOCITY_B_CHANNEL_ID_INDEX, STD_HIGH);

        /*
         *  receive from esp
         */
        uart_receive_string_esp(receive_buffer_1, value_string_1);
        linear_Vel= (Number_esp_1) - 0.01;
        SetPoint_S= (Number_esp_2)- 0.01;

        ///////////////////////////PID//////////////////////////////////
        SetPoint_D=linear_Vel +0.01;
        calc_vel_wheel();
//      measurement= velWheel;
        PID_Compute(ptr,SetPoint_D, velWheel);

        if (test1.Output>0.0)
        {
            set_DutyCycle( PWM0_PB5 , (test1.Output)/1000.0   ,DOWN_MODE);
            Dio_WriteChannel(DioConf_DIFFERENTIAL_INT1_CHANNEL_ID_INDEX, STD_HIGH);
            Dio_WriteChannel(DioConf_DIFFERENTIAL_INT2_CHANNEL_ID_INDEX, STD_LOW);
        }
        if (test1.Output<0.0)
        {
            set_DutyCycle( PWM0_PB5 , 1-(1-((test1.Output)/1000.0)) ,DOWN_MODE);
            Dio_WriteChannel(DioConf_DIFFERENTIAL_INT1_CHANNEL_ID_INDEX,STD_LOW );
            Dio_WriteChannel(DioConf_DIFFERENTIAL_INT2_CHANNEL_ID_INDEX, STD_HIGH);
        }
        if (test1.Output==0.0)
        {
            set_DutyCycle( PWM0_PB5 , Duty0 ,DOWN_MODE);
            Dio_WriteChannel(DioConf_DIFFERENTIAL_INT1_CHANNEL_ID_INDEX,STD_LOW );
            Dio_WriteChannel(DioConf_DIFFERENTIAL_INT2_CHANNEL_ID_INDEX, STD_LOW);
        }
    }
}
/**********************************************************************************************************************
 *  END OF FILE: FileName.c
 *********************************************************************************************************************/
